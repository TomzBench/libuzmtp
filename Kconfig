## Kconfig
```kconfig
menuconfig LIBUZMTP
	bool "libuzmtp ZMQ support"
	select NET_SOCKETS
	help
		This option enables a lightweight ZMQ stack that supports the dealer 
		protocol.

module = LIBUZMTP
module-str = libuzmtp
source "subsys/logging/Kconfig.template.log_config"
```

## west.yml
```yaml
# Example T2 west.yml, using manifest imports.
manifest:
  remotes:
    - name: zephyrproject-rtos
      url-base: https://github.com/zephyrproject-rtos
  projects:
    - name: zephyr
      remote: zephyrproject-rtos
      revision: v3.0.0
      import: true
  self:
    path: libuzmtp
```
